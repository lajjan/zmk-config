## config/boards/shields/lajjBoard_v2/Kconfig.defconfig
```kconfig
# Copyright (c) 2022 The ZMK Contributors
# SPDX-License-Identifier: MIT

if SHIELD_LAJJBOARD_LEFT_V2

config ZMK_KEYBOARD_NAME
	default "lajjBoardV2"

config ZMK_SPLIT_BLE_ROLE_CENTRAL
	default y

endif

if SHIELD_LAJJBOARD_LEFT_V2 || SHIELD_LAJJBOARD_RIGHT_V2

config ZMK_SPLIT
	default y
endif
```

## config/boards/shields/lajjBoard_v2/Kconfig.shield
```kconfig
# Copyright (c) 2022 The ZMK Contributors
# SPDX-License-Identifier: MIT

config SHIELD_LAJJBOARD_LEFT_V2
	def_bool $(shields_list_contains,lajjboard_left_v2)

config SHIELD_LAJJBOARD_RIGHT_V2
	def_bool $(shields_list_contains,lajjboard_right_v2)
```
